## ScottoBigum/ZMK/config/boards/shields/scottobigum/Kconfig.defconfig
```kconfig
if SHIELD_SCOTTOBIGUM

config ZMK_KEYBOARD_NAME
    default "ScottoBigum"

endif
```

## ScottoChoczard/ZMK/config/boards/shields/scottochoczard/Kconfig.defconfig
```kconfig
if SHIELD_SCOTTOCHOCZARD_LEFT

config ZMK_KEYBOARD_NAME
    default "ScottoChoczard"

config ZMK_SPLIT_ROLE_CENTRAL
    default y

endif

if SHIELD_SCOTTOCHOCZARD_LEFT || SHIELD_SCOTTOCHOCZARD_RIGHT

config ZMK_SPLIT
    default y

endif
```

## ScottoChoczard/ZMK/config/boards/shields/scottochoczard/Kconfig.shield
```kconfig
config SHIELD_SCOTTOCHOCZARD_LEFT
    def_bool $(shields_list_contains,scottochoczard_left)

config SHIELD_SCOTTOCHOCZARD_RIGHT
    def_bool $(shields_list_contains,scottochoczard_right)
    
```

## ScottoChoczard/ZMK/config/west.yml
```yaml
manifest:
  remotes:
    - name: zmkfirmware
      url-base: https://github.com/zmkfirmware
    # Additional modules containing boards/shields/custom code can be listed here as well
    # See https://docs.zephyrproject.org/3.2.0/develop/west/manifest.html#projects
  projects:
    - name: zmk
      remote: zmkfirmware
      revision: main
      import: app/west.yml
  self:
    path: config
```
